## hw/sh4/Kconfig
```kconfig
config R2D
    bool
    default y
    depends on SH4
    imply PCI_DEVICES
    imply TEST_DEVICES
    imply RTL8139_PCI
    select I82378 if TEST_DEVICES
    select IDE_MMIO
    select PFLASH_CFI02
    select PCI
    select SM501
    select SH7750
    select SH_PCI

config SH7750
    bool
    select SH_INTC
    select SH_SCI
    select SH_TIMER

config SH7785
    bool
    select SH7785_PCIC
    select SH_INTC
    select SH_SCI
    select SH_TIMER
    select OR_IRQ

config SH7785LCR
    bool
    default y
    depends on SH4
    select SH7785
    select PFLASH_CFI02
    select USB_R8A66597
    select USB_STORAGE_BOT
    select SM501
    select PCA9564
    select RS5C372_RTC
    select LED
    select CG200
    imply PCI_DEVICES
    imply E1000_PCI
    imply RTL8139_PCI
    imply RTL8169_PCI
    imply IDE_SII3112
```
